## drivers/audio/Kconfig.dmic_silabs_pdm
```kconfig
# Copyright (c) 2026 Silicon Laboratories Inc.
# SPDX-License-Identifier: Apache-2.0

config AUDIO_DMIC_SILABS_PDM
	bool "Silicon Labs PDM driver"
	default y
	depends on DT_HAS_SILABS_PDM_ENABLED
	depends on CLOCK_CONTROL
	select DMA
	select PINCTRL
	select SILABS_SISDK_PDM
	help
	  Enable support for the PDM peripheral on Silicon Labs Series 2 SoCs.

if AUDIO_DMIC_SILABS_PDM

config AUDIO_DMIC_SILABS_PDM_QUEUE_SIZE
	int "Received blocks queued to the application"
	default 4
	range 1 64
	help
	  Number of filled blocks waiting for dmic_read(). Blocks are dropped once the queue is
	  full.

endif # AUDIO_DMIC_SILABS_PDM
```

## dts/bindings/audio/silabs,pdm.yaml
```yaml
# Copyright (c) 2026 Silicon Laboratories Inc.
# SPDX-License-Identifier: Apache-2.0

title: Silicon Labs PDM (Pulse Density Modulation)

description: |
  PDM (Pulse Density Modulation) interface for Silicon Labs Series 2 SoCs.

  The PDM peripheral decimates the bitstream from up to two digital microphones sharing one
  clock and one data line into PCM samples. The left microphone is sampled on the rising edge
  of the PDM clock, and the right microphone on the falling edge.

  Received samples are moved to memory using LDMA, so the node must reference a DMA channel
  named "rx".

examples:
  - |
    &pinctrl {
      pdm0_default: pdm0_default {
        group0 {
          pins = <PDM_CLK_PB0>;
          drive-push-pull;
          output-low;
        };

        group1 {
          pins = <PDM_DAT0_PB1>;
          input-enable;
        };
      };
    };

    &pdm0 {
      pinctrl-0 = <&pdm0_default>;
      pinctrl-names = "default";
      status = "okay";
    };

compatible: "silabs,pdm"

include: [base.yaml, pinctrl-device.yaml]

properties:
  reg:
    required: true

  clocks:
    required: true

  dmas:
    required: true

  dma-names:
    required: true

  pinctrl-0:
    required: true

  pinctrl-names:
    required: true
```

## dts/bindings/spi/silabs,eusart-spi.yaml
```yaml
title: |
  Silicon Labs Series 2 EUSART (Enhanced Universal Synchronous/Asynchronous Receiver/Transmitter)

description: |
  EUSART (Enhanced Universal Synchronous/Asynchronous Receiver/Transmitter) peripheral for
  Silicon Labs Series 2 SoCs used in SPI mode.

  The TX signal is MOSI and the RX signal is MISO in both controller and peripheral mode,
  so a peripheral receives on TX and transmits on RX. In peripheral mode, the CS signal must
  be routed through pinctrl, and the instance needs DMA channels configured with dmas and
  dma-names.

examples:
  - |
    /* Controller mode with a GPIO chip select and DMA */
    &pinctrl {
      eusart1_default: eusart1_default {
        group0 {
          pins = <EUSART1_TX_PC1>, <EUSART1_SCLK_PC3>;
          drive-push-pull;
          output-high;
        };

        group1 {
          pins = <EUSART1_RX_PC2>;
          input-enable;
        };
      };
    };

    &eusart1 {
      compatible = "silabs,eusart-spi";
      #address-cells = <1>;
      #size-cells = <0>;
      pinctrl-0 = <&eusart1_default>;
      pinctrl-names = "default";
      cs-gpios = <&gpioc 0 GPIO_ACTIVE_LOW>;
      dmas = <&dma0 DMA_REQSEL_EUSART1TXFL>, <&dma0 DMA_REQSEL_EUSART1RXFL>;
      dma-names = "tx", "rx";
      status = "okay";

      sensor@0 {
        compatible = "vnd,spi-device";
        reg = <0>;
        spi-max-frequency = <DT_FREQ_M(1)>;
      };
    };

  - |
    /* Peripheral mode: TX is the MOSI input, RX is the MISO output and CS is routed through
     * pinctrl. DMA is required.
     */
    &pinctrl {
      eusart1_default: eusart1_default {
        group0 {
          pins = <EUSART1_RX_PC0>;
          drive-push-pull;
          output-high;
        };

        group1 {
          pins = <EUSART1_TX_PC1>, <EUSART1_SCLK_PC3>, <EUSART1_CS_PC2>;
          input-enable;
        };
      };
    };

    &eusart1 {
      compatible = "silabs,eusart-spi";
      pinctrl-0 = <&eusart1_default>;
      pinctrl-names = "default";
      dmas = <&dma0 DMA_REQSEL_EUSART1TXFL>, <&dma0 DMA_REQSEL_EUSART1RXFL>;
      dma-names = "tx", "rx";
      status = "okay";
    };

compatible: "silabs,eusart-spi"

include: [spi-controller.yaml, pinctrl-device.yaml]

properties:
  reg:
    required: true

  interrupts:
    required: true

  pinctrl-0:
    required: true

  pinctrl-names:
    required: true

  clocks:
    required: true
```

## soc/silabs/silabs_s2/Kconfig
```kconfig
# Copyright (c) 2024 GARDENA GmbH
# SPDX-License-Identifier: Apache-2.0

if SOC_FAMILY_SILABS_S2

config SOC_FAMILY_SILABS_S2
	select HAS_SEGGER_RTT if ZEPHYR_SEGGER_MODULE
	select BUILD_OUTPUT_HEX
	select SOC_PREP_HOOK
	select SOC_EARLY_INIT_HOOK
	select HAS_SILABS_SISDK

config SOC_SILABS_IMAGE_PROPERTIES
	bool "Include application properties data structure in image"
	default y if MCUBOOT
	help
	  Include the Silicon Labs application properties data structure in the
	  the firmware image. This allows the SE and Gecko bootloader to access
	  information about the image, such as its version and capabilities. If
	  MCUboot is used, only the MCUboot image itself needs the image
	  properties data structure to enable the SE to perform secure boot
	  verification of the bootloader. MCUboot uses its own TLV format to
	  verify the application. If Gecko bootloader is used, the Zephyr
	  application image also needs the data structure.

rsource "*/Kconfig"

config ARM_SECURE_FIRMWARE
	default y

config SILABS_DEVICE_IS_MODULE
	bool
	default n

if MBEDTLS_PSA_CRYPTO_C

config MBEDTLS_PSA_CRYPTO_SILABS_DRIVER_WRAPPER
	bool "PSA Crypto Driver Wrapper with Silicon Labs hardware acceleration support"
	default y if !MBEDTLS_PSA_CRYPTO_BUILTIN_DRIVER_WRAPPER

config PSA_CRYPTO_DRIVER_SILABS_HSE
	bool "PSA Crypto Driver for Secure Engine"
	depends on MBEDTLS_PSA_CRYPTO_SILABS_DRIVER_WRAPPER
	depends on $(dt_has_compat,$(DT_COMPAT_SILABS_GECKO_SEMAILBOX))
	default y

endif

endif
```

## tests/drivers/spi/spi_error_cases/Kconfig
```kconfig
# Copyright (c) 2026 Silicon Laboratories Inc.
#
# SPDX-License-Identifier: Apache-2.0

# Capabilities of the tested SPI drivers that select the error cases valid on
# a given platform. A test case that checks that an unsupported configuration
# is rejected is skipped when the driver supports that configuration.

config TEST_SPI_HALF_DUPLEX_SUPPORTED
	bool "Driver supports SPI_HALF_DUPLEX"
	help
	  Set this Kconfig to 'y' if both the controller and the peripheral accept
	  operation=SPI_HALF_DUPLEX.

config TEST_SPI_MODE_LOOP_SUPPORTED
	bool "Driver supports SPI_MODE_LOOP"
	help
	  Set this Kconfig to 'y' if both the controller and the peripheral accept
	  operation=SPI_MODE_LOOP.

config TEST_SPI_LINES_DUAL_SUPPORTED
	bool "Driver supports SPI_LINES_DUAL"
	help
	  Set this Kconfig to 'y' if both the controller and the peripheral accept
	  operation=SPI_LINES_DUAL.

config TEST_SPI_LINES_QUAD_SUPPORTED
	bool "Driver supports SPI_LINES_QUAD"
	help
	  Set this Kconfig to 'y' if both the controller and the peripheral accept
	  operation=SPI_LINES_QUAD.

config TEST_SPI_LINES_OCTAL_SUPPORTED
	bool "Driver supports SPI_LINES_OCTAL"
	help
	  Set this Kconfig to 'y' if both the controller and the peripheral accept
	  operation=SPI_LINES_OCTAL.

config TEST_SPI_WORD_SIZE_16_SUPPORTED
	bool "Driver supports 16-bit words"
	help
	  Set this Kconfig to 'y' if both the controller and the peripheral accept
	  operation=SPI_WORD_SET(16).

config TEST_SPI_CONTROLLER_INSTANCE_PERIPHERAL_SUPPORTED
	bool "Controller instance also supports peripheral mode"
	help
	  Set this Kconfig to 'y' if the instance used as controller also accepts
	  operation=SPI_OP_MODE_PERIPHERAL.

config TEST_SPI_PERIPHERAL_INSTANCE_CONTROLLER_SUPPORTED
	bool "Peripheral instance also supports controller mode"
	help
	  Set this Kconfig to 'y' if the instance used as peripheral also accepts
	  operation=SPI_OP_MODE_CONTROLLER.

config TEST_SPI_UNSUPPORTED_FREQUENCY
	int "Controller frequency that the driver must reject"
	default 124999 if SPI_NRFX_SPIM
	default 0
	help
	  Frequency in Hz that is outside of the range supported by the controller.
	  Set to 0 if the driver supports any frequency, or adjusts unsupported
	  frequencies, to skip the test case.

config TEST_SPI_PERIPHERAL_UNSUPPORTED_FREQUENCY
	int "Peripheral frequency that the driver must reject"
	default 0
	help
	  Frequency in Hz that is higher than the peripheral can receive. Set to 0
	  if the driver does not check the frequency in peripheral mode to skip
	  the test case.

config TEST_SPI_PERIPHERAL_SCATTERED_BUFFERS_SUPPORTED
	bool "Peripheral supports buffer sets with more than one buffer"
	help
	  Set this Kconfig to 'y' if the peripheral accepts TX and RX buffer sets
	  with more than one buffer.

config TEST_SPI_PERIPHERAL_UNSUPPORTED_BUF_LEN
	int "Peripheral buffer length that the driver must reject"
	default 65536 if SPI_NRFX_SPIS
	default 0
	help
	  Length of a single TX or RX buffer that exceeds what the peripheral
	  supports. Set to 0 if the driver has no such limit to skip the test
	  cases.

config TEST_SPI_PERIPHERAL_RAM_BUFFERS_ONLY
	bool "Peripheral only supports buffers in RAM"
	default y if SPI_NRFX_SPIS
	help
	  Set this Kconfig to 'y' if the peripheral rejects TX buffers that are
	  not located in RAM.

source "Kconfig.zephyr"
```
