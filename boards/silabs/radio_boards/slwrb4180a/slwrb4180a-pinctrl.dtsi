/*
 * Copyright (c) 2023 Antmicro <www.antmicro.com>
 * Copyright (c) 2024 Silicon Laboratories Inc.
 *
 * SPDX-License-Identifier: Apache-2.0
 */

#include <dt-bindings/pinctrl/silabs/xg21-pinctrl.h>

&pinctrl {
	usart0_default: usart0_default {
		out {
			pins = <USART0_TX_PA5>;
			drive-push-pull;
			output-high;
		};
		in {
			pins = <USART0_RX_PA6>;
			input-enable;
			silabs,input-filter;
		};
	};
};
