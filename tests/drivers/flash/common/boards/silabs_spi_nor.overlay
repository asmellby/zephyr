/*
 * Copyright (c) 2026 Silicon Laboratories Inc.
 *
 * SPDX-License-Identifier: Apache-2.0
 */

/* Test the on-board MX25R8035F jedec spi nor flash instead of internal flash */

/delete-node/ &storage_partition;

&mx25r80 {
	partitions {
		compatible = "fixed-partitions";
		#address-cells = <1>;
		#size-cells = <1>;

		/* Two 64 KiB layout pages at the end of the 1 MiB flash */
		storage_partition: partition@e0000 {
			label = "storage";
			reg = <0x000e0000 0x00020000>;
		};
	};
};
