/*
 * Copyright (c) 2026 Silicon Laboratories Inc.
 *
 * SPDX-License-Identifier: Apache-2.0
 */

/*
 * Connect EXP4 (PD7) and EXP3 (PB5) of the Expansion Pin header
 */

/ {
	resources {
		compatible = "test-gpio-basic-api";
		out-gpios = <&exp_header 4 0>; /* WSTK EXP4 (PD7) */
		in-gpios = <&exp_header 3 0>; /* WSTK EXP3 (PB5) */
	};
};
